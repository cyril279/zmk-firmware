## app/boards/shields/r41lp/Kconfig.defconfig
```kconfig
# Copyright (c) 2020 The ZMK Contributors
# SPDX-License-Identifier: MIT

if SHIELD_R41LP

config ZMK_KEYBOARD_NAME
    default "R41lp"

endif
```

## app/boards/shields/r41lp/Kconfig.shield
```kconfig
# Copyright (c) 2020 The ZMK Contributors
# SPDX-License-Identifier: MIT

config SHIELD_R41LP
    def_bool $(shields_list_contains,r41lp)
```
